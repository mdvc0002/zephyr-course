## boards/my_board/Kconfig.defconfig
```kconfig
if BOARD_MY_BOARD

config SPI_STM32_INTERRUPT
	default y
	depends on SPI
    
endif # BOARD_MY_BOARD
```

## boards/my_board/board.yml
```yaml
board:
  name: my_board
  full_name: Nucleo F446RE. My board from scratch
  vendor: iomico
  socs:
    - name: stm32f446xx
```

## boards/our_board/board.yml
```yaml
board:
  name: our_board
  full_name: Nucleo F446RE
  vendor: iomico
  socs:
    - name: stm32f446xx
```
